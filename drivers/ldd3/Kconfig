## drivers/ldd3/Kconfig
```kconfig
#
# ldd3 configuration
#

menu "ldd3"

source "drivers/ldd3/scull/Kconfig"

source "drivers/ldd3/misc-modules/Kconfig"

source "drivers/ldd3/scullc/Kconfig"

source "drivers/ldd3/scullp/Kconfig"

#source "drivers/ldd3/scullv/Kconfig"
endmenu
```

## drivers/ldd3/misc-modules/Kconfig
```kconfig
#
# Simple Character Utility for Loading Localities
#

config MISC_MODULES 
	bool "kernel misc modules"
    default n
	---help---
      from ldd3
```

## drivers/ldd3/scull/Kconfig
```kconfig
#
# Simple Character Utility for Loading Localities
#

config SCULL
	bool "scull"
    default n
	---help---
      from ldd3 chapter 3 
```

## drivers/ldd3/scullc/Kconfig
```kconfig
#
# Simple Character Utility for Loading Localities
#

config SCULLC
	bool "scullc"
    default n
	---help---
        use lookaside cache to implement SCULL 
```

## drivers/ldd3/scullp/Kconfig
```kconfig
#
# Simple Character Utility for Loading Localities
#

config SCULLP
	bool "scullp"
    default n
	---help---
        use lookaside cache to implement SCULL 
```
